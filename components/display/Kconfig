## components/display/Kconfig
```kconfig
menu "Display (ST7735 + LVGL)"

    config DISPLAY_ENABLED
        bool "Bring up the display"
        default y
        help
            Unset to leave the panel dark and skip LVGL entirely. The API stays
            present and reports ESP_ERR_NOT_SUPPORTED.

    menu "Wiring"
        depends on DISPLAY_ENABLED

        config DISPLAY_SPI_HOST
            int "SPI host"
            default 2
            range 2 3
            help
                2 is SPI2_HOST, 3 is SPI3_HOST. Must differ from the host the
                APA102 status LED uses, which defaults to 3.

        config DISPLAY_PIN_SCLK
            int "SCLK GPIO"
            default 5
            range 0 48

        config DISPLAY_PIN_MOSI
            int "MOSI GPIO"
            default 3
            range 0 48

        config DISPLAY_PIN_CS
            int "CS GPIO"
            default 4
            range -1 48

        config DISPLAY_PIN_DC
            int "DC GPIO"
            default 2
            range 0 48

        config DISPLAY_PIN_RST
            int "RST GPIO, -1 for a software reset"
            default 1
            range -1 48

        config DISPLAY_PIN_BACKLIGHT
            int "Backlight GPIO, -1 if it is not switchable"
            default 38
            range -1 48
            help
                The T-Dongle S3 examples drive GPIO38. Some board revisions use
                GPIO37 instead -- if the panel initialises but stays dark, that
                is the first thing to try.

        config DISPLAY_BACKLIGHT_ACTIVE_HIGH
            bool "Backlight is on when the pin is high"
            default n
            help
                Off for the T-Dongle S3 Plus. The pin drives the LED anode
                through a switch, so LilyGO's own code lights it by writing 0
                (LCD_BK_LIGHT_ON 0). Set this if a board does the opposite.

        config DISPLAY_PCLK_HZ
            int "SPI clock, in Hz"
            default 30000000
            range 1000000 80000000
            help
                30MHz is what LilyGO's own configuration uses. Drop it if the
                panel shows torn or speckled frames.
    endmenu

    menu "Panel"
        depends on DISPLAY_ENABLED

        config DISPLAY_H_RES
            int "Horizontal resolution"
            default 160
            range 1 1024

        config DISPLAY_V_RES
            int "Vertical resolution"
            default 80
            range 1 1024

        config DISPLAY_X_GAP
            int "Column offset into panel memory"
            default 1
            help
                The 0.96" 160x80 module maps onto a larger controller memory,
                so the visible area starts part way in. 1 and 26 are the
                offsets that go with the swap and mirror below.

        config DISPLAY_Y_GAP
            int "Row offset into panel memory"
            default 26

        config DISPLAY_SWAP_XY
            bool "Swap the axes"
            default y

        config DISPLAY_MIRROR_X
            bool "Mirror horizontally"
            default n

        config DISPLAY_MIRROR_Y
            bool "Mirror vertically"
            default y

        config DISPLAY_INVERT_COLOR
            bool "Invert colour"
            default y
            help
                This panel is fitted the inverted way round; without this,
                black shows white.

        config DISPLAY_BGR_ORDER
            bool "Panel expects BGR rather than RGB"
            default y
    endmenu

    config DISPLAY_LVGL_BUFFER_LINES
        int "LVGL draw buffer, in lines"
        depends on DISPLAY_ENABLED
        default 20
        range 1 1024
        help
            Two buffers of this many full-width lines are allocated in DMA
            memory. 20 lines of 160 pixels is 6.4kB each.

endmenu
```

## components/neopixel/Kconfig
```kconfig
menu "Status LED (neopixel)"

    choice NEOPIXEL_MODEL
        prompt "LED type"
        default NEOPIXEL_MODEL_APA102
        help
            Two wire protocols that are not interchangeable. The T-Dongle S3
            Plus carries an APA102 on two pins, data and clock; most bare LED
            strips are WS2812 and use one.

        config NEOPIXEL_MODEL_WS2812
            bool "WS2812 / SK6812 -- one wire, driven by RMT"

        config NEOPIXEL_MODEL_APA102
            bool "APA102 / SK9822 -- two wires, driven by SPI"
    endchoice

    config NEOPIXEL_DATA_GPIO
        int "Data GPIO"
        default 40
        range 0 48
        help
            GPIO40 on the T-Dongle S3 Plus, labelled RGB DIN.

    config NEOPIXEL_CLK_GPIO
        int "Clock GPIO"
        depends on NEOPIXEL_MODEL_APA102
        default 39
        range 0 48
        help
            GPIO39 on the T-Dongle S3 Plus, labelled RGB CLK.

    config NEOPIXEL_SPI_HOST
        int "SPI host for the APA102"
        depends on NEOPIXEL_MODEL_APA102
        default 3
        range 2 3
        help
            The peripheral's name: 2 for SPI2, 3 for SPI3. Keep it off the host
            the display uses: the LED has no chip select, so its bus cannot be
            shared.

    config NEOPIXEL_SPI_HZ
        int "APA102 clock, in Hz"
        depends on NEOPIXEL_MODEL_APA102
        default 10000000
        range 100000 40000000

    config NEOPIXEL_COUNT
        int "Number of LEDs"
        default 1
        range 1 512

    config NEOPIXEL_BRIGHTNESS
        int "Default brightness, 0 - 255"
        default 64
        range 0 255
        help
            Overridden by led.brightness in config.json once that is loaded.
            An APA102 dims through a 5-bit current register, so 8/255 lands on
            level 1 of 31 and is invisible in daylight; LilyGO's own example
            runs this LED at 100. 64 is a quarter scale, bright enough to read
            across a room without being painful.

endmenu
```

## components/now_connect/Kconfig
```kconfig
menu "NowConnect (ESP-NOW link)"

    choice NOW_CONNECT_ROLE
        prompt "Device role"
        default NOW_CONNECT_ROLE_MASTER
        help
            Which end of the link this firmware is. Exactly one master and one
            slave pair with each other; two devices of the same role ignore
            each other's pairing requests.

        config NOW_CONNECT_ROLE_MASTER
            bool "Master -- the dongle plugged into the computer"

        config NOW_CONNECT_ROLE_SLAVE
            bool "Slave -- the control surface that reports to it"
    endchoice

    config NOW_CONNECT_CHANNEL
        int "Wi-Fi channel"
        default 1
        range 1 13
        help
            Neither end joins an access point, so the channel is fixed here and
            must be the same on both devices.

    config NOW_CONNECT_PAIR_GPIO
        int "Pairing button GPIO"
        default 0
        range -1 48
        help
            Held down to open the pairing window. -1 leaves the button out
            entirely, in which case only now_connect_start_pairing() opens it.

    config NOW_CONNECT_PAIR_ACTIVE_HIGH
        bool "Pairing button reads high when pressed"
        default n
        help
            Leave unset for the usual button to ground with a pull-up, which is
            how GPIO0 is wired on the T-Dongle S3.

    config NOW_CONNECT_PAIR_HOLD_MS
        int "Hold time that opens pairing, in milliseconds"
        default 3000
        range 200 30000

    config NOW_CONNECT_PAIR_WINDOW_S
        int "How long the pairing window stays open, in seconds"
        default 60
        range 5 600

    config NOW_CONNECT_BATTERY_MINUTES
        int "Battery report interval, in minutes"
        default 1
        range 1 255
        help
            Fallback only. The interval actually used comes from
            pair.battery_min in config.json.

    config NOW_CONNECT_HEARTBEAT_MS
        int "Heartbeat interval, in milliseconds"
        default 1000
        range 100 60000
        help
            Sent only when nothing else has gone out, so a device reporting
            continuously never adds traffic of its own.

    config NOW_CONNECT_LINK_TIMEOUT_MS
        int "Silence that marks the link down, in milliseconds"
        default 3500
        range 200 120000
        help
            Should be a small multiple of the heartbeat interval.

endmenu
```
